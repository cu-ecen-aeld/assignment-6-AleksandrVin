## nographic/conf/bblayers.conf
```bitbake
# POKY_BBLAYERS_CONF_VERSION is increased each time build/conf/bblayers.conf
# changes incompatibly
POKY_BBLAYERS_CONF_VERSION = "2"

BBPATH = "${TOPDIR}"
BBFILES ?= ""

BBLAYERS ?= " \
  /home/alek_playground/linux_course/nvme1n1p2/assignment-6-AleksandrVin/poky/meta \
  /home/alek_playground/linux_course/nvme1n1p2/assignment-6-AleksandrVin/poky/meta-poky \
  /home/alek_playground/linux_course/nvme1n1p2/assignment-6-AleksandrVin/poky/meta-yocto-bsp \
  "
```
